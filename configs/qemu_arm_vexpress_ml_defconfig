## configs/qemu_arm_vexpress_ml_defconfig
```kconfig
BR2_arm=y
BR2_cortex_a9=y
BR2_ARM_ENABLE_NEON=y
BR2_ARM_ENABLE_VFP=y
BR2_TOOLCHAIN_BUILDROOT_GLIBC=y
BR2_PACKAGE_HOST_LINUX_HEADERS_CUSTOM_4_9=y
BR2_TOOLCHAIN_BUILDROOT_CXX=y
BR2_TARGET_GENERIC_ROOT_PASSWD="root"
BR2_TARGET_GENERIC_GETTY_PORT="ttyAMA0"
BR2_SYSTEM_DHCP="eth0"
BR2_LINUX_KERNEL=y
BR2_LINUX_KERNEL_CUSTOM_VERSION=y
BR2_LINUX_KERNEL_CUSTOM_VERSION_VALUE="4.9.6"
BR2_LINUX_KERNEL_DEFCONFIG="vexpress"
BR2_LINUX_KERNEL_DTS_SUPPORT=y
BR2_LINUX_KERNEL_INTREE_DTS_NAME="vexpress-v2p-ca9"
BR2_PACKAGE_ZLIB=y
BR2_PACKAGE_WPEFRAMEWORK=y
BR2_PACKAGE_WPEFRAMEWORK_TEST_UNITTESTS=y
# BR2_PACKAGE_WPEFRAMEWORK_COMPOSITORCLIENT is not set
# BR2_PACKAGE_WPEFRAMEWORK_CDMI is not set
# BR2_PACKAGE_WPEFRAMEWORK_DEVICEINFO is not set
# BR2_PACKAGE_WPEFRAMEWORK_DISPLAYINFO is not set
# BR2_PACKAGE_WPEFRAMEWORK_PLAYERINFO is not set
# BR2_PACKAGE_WPEFRAMEWORK_UI is not set
BR2_PACKAGE_DROPBEAR=y
BR2_TARGET_ROOTFS_EXT2=y
# BR2_TARGET_ROOTFS_TAR is not set
BR2_PACKAGE_HOST_UTIL_LINUX=y
```

## package/drmplayer/Config.in
```kconfig
config BR2_PACKAGE_DRMPLAYER
bool "drmplayer"
help 
    Standalone SVP test program.

if BR2_PACKAGE_DRMPLAYER


choice
	prompt "DRMPlayer target platform family."
	default BR2_PACKAGE_DRMPLAYER_NEXUS
	help
	  Choose the target platform family.

	config BR2_PACKAGE_DRMPLAYER_NEXUS
		bool "Nexus"
		depends on BR2_PACKAGE_BCM_REFSW
		depends on BR2_PACKAGE_BCM_REFSW_19_1_1
		depends on BR2_PACKAGE_BCM_REFSW_DIF
		depends on BR2_PACKAGE_BCM_REFSW_PLAYBACK_DIF
		help
		  Nexus platform family.

endchoice

endif
```
